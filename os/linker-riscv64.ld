/* ============================================
 * RISC-V 64 操作系统链接脚本
 * ============================================
 * 功能：定义内核的内存布局和段分配
 * 目标：QEMU virt 机器
 * 基地址：0x80200000（在 OpenSBI 之后加载）
 * 注意：OpenSBI 加载在 0x80000000，占用约 256KB
 */

OUTPUT_ARCH(riscv)
ENTRY(_start)

/* 内存布局配置 */
BASE_ADDRESS = 0x80200000;

SECTIONS
{
    /* 内核加载到 0x80200000（OpenSBI 之后） */
    . = BASE_ADDRESS;

    kernel_start = .;

    /* ============================================
     * .text 段：代码段
     * ============================================ */
    .text : ALIGN(4K) {
        *(.text.entry)      /* 入口代码（_start 函数） */
        *(.text .text.*)    /* 所有代码 */
    }

    /* ============================================
     * .rodata 段：只读数据段
     * ============================================ */
    .rodata : ALIGN(4K) {
        *(.rodata .rodata.*)    /* 只读数据 */
        *(.srodata .srodata.*)  /* 小段只读数据 */
    }

    /* ============================================
     * .data 段：已初始化数据段
     * ============================================ */
    .data : ALIGN(4K) {
        *(.data .data.*)        /* 全局变量 */
        *(.sdata .sdata.*)      /* 小段数据 */
    }

    /* ============================================
     * .bss 段：未初始化数据段
     * ============================================ */
    .bss : ALIGN(4K) {
        bss_start = .;
        *(.bss .bss.*)
        *(.sbss .sbss.*)
        bss_end = .;
    }

    /* ============================================
     * 堆和栈区域（由运行时动态管理）
     * ============================================ */
    .heap : ALIGN(4K) {
        heap_start = .;
        . += 1024K;  /* 1 MB 堆空间 */
        heap_end = .;
    }

    .stack : ALIGN(4K) {
        stack_start = .;
        . += 512K;   /* 512 KB 栈空间 */
        stack_end = .;
    }

    kernel_end = .;

    /* ============================================
     * 丢弃不需要的段
     * ============================================ */
    /DISCARD/ : {
        *(.eh_frame)        /* 异常处理帧 */
        *(.comment)         /* 注释信息 */
    }
}
